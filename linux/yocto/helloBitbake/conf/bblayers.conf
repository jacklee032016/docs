## linux/yocto/helloBitbake/myLayer/conf/layer.conf
```bitbake
BBPATH .= ":${LAYERDIR}"

BBFILES += "${LAYERDIR}/*.bb"

BBFILE_COLLECTIONS += "myLayer"
BBFILE_PATTERN_mylayer := "^${LAYERDIR_RE}/"
```
